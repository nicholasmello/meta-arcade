## conf/layer.conf
```bitbake
# We have a conf and classes directory, append to BBPATH
BBPATH .= ":${LAYERDIR}"

# We have a recipes directory, add to BBFILES
BBFILES += "${LAYERDIR}/recipes*/*/*.bb ${LAYERDIR}/recipes*/*/*.bbappend ${LAYERDIR}/images/*.bb"

BBFILE_COLLECTIONS += "meta-arcade"
BBFILE_PATTERN_meta-arcade := "^${LAYERDIR}/"
BBFILE_PRIORITY_meta-arcade = "16"

LAYERSERIES_COMPAT_meta-arcade = "dunfell"
```
